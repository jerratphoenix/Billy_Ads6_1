## meta-phoenix/meta-archercity/conf/machine/archercity.conf
```bitbake
KMACHINE = "aspeed"
KERNEL_DEVICETREE = "aspeed-bmc-phoenix-archercity.dtb"

require conf/machine/include/ast2600.inc
require conf/machine/include/obmc-bsp-common.inc
require conf/machine/include/phoenix.inc

UBOOT_MACHINE = "ast2600_openbmc_defconfig"
UBOOT_DEVICETREE = "phoenix-archercity"

VIRTUAL-RUNTIME_skeleton_workbook = "${MACHINE}-config"
VIRTUAL-RUNTIME_obmc-host-state-manager = "x86-power-control"
VIRTUAL-RUNTIME_obmc-chassis-state-manager = "x86-power-control"
VIRTUAL-RUNTIME_obmc-discover-system-state = "x86-power-control"

FLASH_SIZE = "65536"
FLASH_KERNEL_OFFSET:flash-65536 = "1024"
FLASH_ROFS_OFFSET:flash-65536 = "8192"
FLASH_RWFS_OFFSET:flash-65536 = "49152"

VOLATILE_LOG_DIR = "no"
```

## meta-phoenix/meta-eaglestream/conf/machine/eaglestream.conf
```bitbake
KMACHINE = "aspeed"
KERNEL_DEVICETREE = "aspeed-bmc-phoenix-eaglestream.dtb"

require conf/machine/include/ast2600.inc
require conf/machine/include/obmc-bsp-common.inc
require conf/machine/include/phoenix.inc

UBOOT_MACHINE = "ast2600_openbmc_defconfig"
UBOOT_DEVICETREE = "phoenix-eaglestream"
#UBOOT_DEVICETREE = "ast2600-intel"

VIRTUAL-RUNTIME_skeleton_workbook = "${MACHINE}-config"

FLASH_SIZE = "65536"
FLASH_KERNEL_OFFSET:flash-65536 = "1024"
FLASH_ROFS_OFFSET:flash-65536 = "8192"
FLASH_RWFS_OFFSET:flash-65536 = "49152"

VOLATILE_LOG_DIR = "no"
```

## meta-phoenix/meta-morocity/conf/machine/morocity.conf
```bitbake
KMACHINE = "aspeed"
KERNEL_DEVICETREE = "aspeed-bmc-phoenix-morocity.dtb"

require conf/machine/include/ast2500.inc
require conf/machine/include/obmc-bsp-common.inc
require conf/machine/include/phoenix.inc

UBOOT_MACHINE = "ast_g5_phy_config"

VIRTUAL-RUNTIME_skeleton_workbook = "${MACHINE}-config"
VIRTUAL-RUNTIME_obmc-host-state-manager = "x86-power-control"
VIRTUAL-RUNTIME_obmc-chassis-state-manager = "x86-power-control"

FLASH_SIZE = "65536"
FLASH_KERNEL_OFFSET:flash-65536 = "1024"
FLASH_ROFS_OFFSET:flash-65536 = "8192"
FLASH_RWFS_OFFSET:flash-65536 = "49152"

VOLATILE_LOG_DIR = "no"
```
